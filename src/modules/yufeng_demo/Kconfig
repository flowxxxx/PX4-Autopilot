## src/modules/yufeng_demo/Kconfig
```kconfig
menuconfig MODULES_YUFENG_DEMO
	bool "yufeng_demo"
	default n
	---help---
		Enable support for yufeng_demo

menuconfig USER_MC_POS_CONTROL
	bool "yufeng_demo running as userspace module"
	default y
	depends on BOARD_PROTECTED && MODULES_YUFENG_DEMO
	---help---
		Put yufeng_demo in userspace memory
```

## src/modules/zhengyu_demo/Kconfig
```kconfig
menuconfig MODULES_ZHENGYU_DEMO
    bool "zhengyu_demo"
    default n
    ---help---
        Enable support for zhengyu_demo

menuconfig USER_MC_POS_CONTROL
    bool "zhengyu_demo running as userspace module"
    default y
    depends on BOARD_PROTECTED && MODULES_ZHENGYU_DEMO
    ---help---
        Put zhengyu_demo in userspace memory
```
