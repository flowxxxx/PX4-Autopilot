## src/modules/fenghai_demo/Kconfig
```kconfig
menuconfig MODULES_FENGHAI_DEMO
	bool "fenghai_demo"
	default n
	---help---
		Enable support for fenghai_demo
		
menuconfig USER_MC_POS_CONTROL

	bool "fenghai_demo running as userspace module"
	default y
	depends on BOARD_PROTECTED && MODULES_FENGHAI_DEMO
	---help---
		Put fenghai_demo in userspace memory
```

## src/modules/jxli_demo/Kconfig
```kconfig
menuconfig MODULES_JXLI_DEMO
	bool "jxli_demo"
	default n
	---help---
		Enable support for jxli_demo

menuconfig USER_MC_POS_CONTROL
	bool "jxli_demo running as userspace module"
	default y
	depends on BOARD_PROTECTED && MODULES_JXLI_DEMO
	---help---
		Put jxli_demo in userspace memory
```

## src/modules/lizhi_demo/Kconfig
```kconfig
menuconfig MODULES_LIZHI_DEMO
	bool "lizhi_demo"
	default n
	---help---
		Enable support for lizhi_demo

menuconfig USER_MC_POS_CONTROL
	bool "lizhi_demo running as userspace module"
	default y
	depends on BOARD_PROTECTED && MODULES_LIZHI_DEMO
	---help---
		Put lizhi_demo in userspace memory
```

## src/modules/pengbo_demo/Kconfig
```kconfig
menuconfig MODULES_pengbo_DEMO
	bool "pengbo_demo"
	default n
	---help---
		Enable support for pengbo_demo

menuconfig USER_MC_POS_CONTROL
	bool "pengbo_demo running as userspace module"
	default y
	depends on BOARD_PROTECTED && MODULES_pengbo_DEMO
	---help---
		Put pengbo_demo in userspace memory
```

## src/modules/yiming_demo/Kconfig
```kconfig
menuconfig MODULES_YIMING_DEMO
	bool "yiming_demo"
	default n
	---help---
		Enable support for yiming_demo

menuconfig USER_MC_POS_CONTROL
	bool "yiming_demo running as userspace module"
	default y
	depends on BOARD_PROTECTED && MODULES_YIMING_DEMO
	---help---
		Put yiming_demo in userspace memory
```
